## config/boards/shields/totem_dongle/Kconfig.shield
```kconfig
# Copyright 2025 Manna Harbour
# https://github.com/manna-harbour/miryoku

config SHIELD_TOTEM_DONGLE
    def_bool $(shields_list_contains,totem_dongle)
```
